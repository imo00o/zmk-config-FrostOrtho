## config/boards/shields/FrostOrtho/Kconfig.defconfig
```kconfig
if SHIELD_FROSTORTHO_R

config ZMK_KEYBOARD_NAME
    default "FrostOrtho_R"

config ZMK_SPLIT
    default y

config ZMK_SPLIT_ROLE_CENTRAL
    default y

config ZMK_POINTING     # paw3222
    default y

config PAW3222      # paw3222
    default y

endif


if SHIELD_FROSTORTHO_L

config ZMK_KEYBOARD_NAME
    default "FrostOrtho_L"

config ZMK_SPLIT
    default y

endif
```

## config/boards/shields/FrostOrtho/Kconfig.shield
```kconfig
config SHIELD_FROSTORTHO_R
    def_bool $(shields_list_contains,FrostOrtho_R)

config SHIELD_FROSTORTHO_L
    def_bool $(shields_list_contains,FrostOrtho_L)
```
